## samples/ifm_sample_app/build_esp/Kconfig/soc/Kconfig.sysbuild
```kconfig
# Load SoC sysbuild Kconfig descriptions.
osource "C:/Users/vc9917e/zephyr_latest/zephyr/soc/xlnx/zynqmp/Kconfig.sysbuild"
osource "C:/Users/vc9917e/zephyr_latest/zephyr/soc/xlnx/zynq7000/Kconfig.sysbuild"
osource "C:/Users/vc9917e/zephyr_latest/zephyr/soc/xen/Kconfig.sysbuild"
osource "C:/Users/vc9917e/zephyr_latest/zephyr/soc/ti/simplelink/Kconfig.sysbuild"
osource "C:/Users/vc9917e/zephyr_latest/zephyr/soc/ti/lm3s6965/Kconfig.sysbuild"
osource "C:/Users/vc9917e/zephyr_latest/zephyr/soc/ti/k3/Kconfig.sysbuild"
osource "C:/Users/vc9917e/zephyr_latest/zephyr/soc/telink/tlsr/Kconfig.sysbuild"
osource "C:/Users/vc9917e/zephyr_latest/zephyr/soc/starfive/jh71xx/Kconfig.sysbuild"
osource "C:/Users/vc9917e/zephyr_latest/zephyr/soc/st/stm32/Kconfig.sysbuild"
osource "C:/Users/vc9917e/zephyr_latest/zephyr/soc/snps/qemu_arc/Kconfig.sysbuild"
osource "C:/Users/vc9917e/zephyr_latest/zephyr/soc/snps/nsim/Kconfig.sysbuild"
osource "C:/Users/vc9917e/zephyr_latest/zephyr/soc/snps/hsdk4xd/Kconfig.sysbuild"
osource "C:/Users/vc9917e/zephyr_latest/zephyr/soc/snps/hsdk/Kconfig.sysbuild"
osource "C:/Users/vc9917e/zephyr_latest/zephyr/soc/snps/emsk/Kconfig.sysbuild"
osource "C:/Users/vc9917e/zephyr_latest/zephyr/soc/snps/emsdp/Kconfig.sysbuild"
osource "C:/Users/vc9917e/zephyr_latest/zephyr/soc/snps/arc_iot/Kconfig.sysbuild"
osource "C:/Users/vc9917e/zephyr_latest/zephyr/soc/silabs/Kconfig.sysbuild"
osource "C:/Users/vc9917e/zephyr_latest/zephyr/soc/sifive/sifive_freedom/Kconfig.sysbuild"
osource "C:/Users/vc9917e/zephyr_latest/zephyr/soc/rockchip/Kconfig.sysbuild"
osource "C:/Users/vc9917e/zephyr_latest/zephyr/soc/renode/riscv_virtual/Kconfig.sysbuild"
osource "C:/Users/vc9917e/zephyr_latest/zephyr/soc/renesas/smartbond/Kconfig.sysbuild"
osource "C:/Users/vc9917e/zephyr_latest/zephyr/soc/renesas/rzt2m/Kconfig.sysbuild"
osource "C:/Users/vc9917e/zephyr_latest/zephyr/soc/renesas/rcar/Kconfig.sysbuild"
osource "C:/Users/vc9917e/zephyr_latest/zephyr/soc/renesas/ra/Kconfig.sysbuild"
osource "C:/Users/vc9917e/zephyr_latest/zephyr/soc/raspberrypi/Kconfig.sysbuild"
osource "C:/Users/vc9917e/zephyr_latest/zephyr/soc/quicklogic/eos_s3/Kconfig.sysbuild"
osource "C:/Users/vc9917e/zephyr_latest/zephyr/soc/qemu/virt_riscv/Kconfig.sysbuild"
osource "C:/Users/vc9917e/zephyr_latest/zephyr/soc/qemu/malta/Kconfig.sysbuild"
osource "C:/Users/vc9917e/zephyr_latest/zephyr/soc/openisa/rv32m1/Kconfig.sysbuild"
osource "C:/Users/vc9917e/zephyr_latest/zephyr/soc/nxp/s32/Kconfig.sysbuild"
osource "C:/Users/vc9917e/zephyr_latest/zephyr/soc/nxp/rw/Kconfig.sysbuild"
osource "C:/Users/vc9917e/zephyr_latest/zephyr/soc/nxp/mcx/Kconfig.sysbuild"
osource "C:/Users/vc9917e/zephyr_latest/zephyr/soc/nxp/lpc/Kconfig.sysbuild"
osource "C:/Users/vc9917e/zephyr_latest/zephyr/soc/nxp/layerscape/Kconfig.sysbuild"
osource "C:/Users/vc9917e/zephyr_latest/zephyr/soc/nxp/kinetis/Kconfig.sysbuild"
osource "C:/Users/vc9917e/zephyr_latest/zephyr/soc/nxp/imxrt/Kconfig.sysbuild"
osource "C:/Users/vc9917e/zephyr_latest/zephyr/soc/nxp/imx/Kconfig.sysbuild"
osource "C:/Users/vc9917e/zephyr_latest/zephyr/soc/nuvoton/numicro/Kconfig.sysbuild"
osource "C:/Users/vc9917e/zephyr_latest/zephyr/soc/nuvoton/numaker/Kconfig.sysbuild"
osource "C:/Users/vc9917e/zephyr_latest/zephyr/soc/nuvoton/npcx/Kconfig.sysbuild"
osource "C:/Users/vc9917e/zephyr_latest/zephyr/soc/nordic/Kconfig.sysbuild"
osource "C:/Users/vc9917e/zephyr_latest/zephyr/soc/neorv32/Kconfig.sysbuild"
osource "C:/Users/vc9917e/zephyr_latest/zephyr/soc/native/inf_clock/Kconfig.sysbuild"
osource "C:/Users/vc9917e/zephyr_latest/zephyr/soc/microchip/miv/Kconfig.sysbuild"
osource "C:/Users/vc9917e/zephyr_latest/zephyr/soc/microchip/mec/Kconfig.sysbuild"
osource "C:/Users/vc9917e/zephyr_latest/zephyr/soc/lowrisc/opentitan/Kconfig.sysbuild"
osource "C:/Users/vc9917e/zephyr_latest/zephyr/soc/litex/litex_vexriscv/Kconfig.sysbuild"
osource "C:/Users/vc9917e/zephyr_latest/zephyr/soc/ite/ec/Kconfig.sysbuild"
osource "C:/Users/vc9917e/zephyr_latest/zephyr/soc/intel/raptor_lake/Kconfig.sysbuild"
osource "C:/Users/vc9917e/zephyr_latest/zephyr/soc/intel/lakemont/Kconfig.sysbuild"
osource "C:/Users/vc9917e/zephyr_latest/zephyr/soc/intel/intel_socfpga_std/Kconfig.sysbuild"
osource "C:/Users/vc9917e/zephyr_latest/zephyr/soc/intel/intel_socfpga/Kconfig.sysbuild"
osource "C:/Users/vc9917e/zephyr_latest/zephyr/soc/intel/intel_niosv/Kconfig.sysbuild"
osource "C:/Users/vc9917e/zephyr_latest/zephyr/soc/intel/intel_ish/Kconfig.sysbuild"
osource "C:/Users/vc9917e/zephyr_latest/zephyr/soc/intel/intel_adsp/Kconfig.sysbuild"
osource "C:/Users/vc9917e/zephyr_latest/zephyr/soc/intel/elkhart_lake/Kconfig.sysbuild"
osource "C:/Users/vc9917e/zephyr_latest/zephyr/soc/intel/atom/Kconfig.sysbuild"
osource "C:/Users/vc9917e/zephyr_latest/zephyr/soc/intel/apollo_lake/Kconfig.sysbuild"
osource "C:/Users/vc9917e/zephyr_latest/zephyr/soc/intel/alder_lake/Kconfig.sysbuild"
osource "C:/Users/vc9917e/zephyr_latest/zephyr/soc/infineon/xmc/Kconfig.sysbuild"
osource "C:/Users/vc9917e/zephyr_latest/zephyr/soc/gd/gd32/Kconfig.sysbuild"
osource "C:/Users/vc9917e/zephyr_latest/zephyr/soc/gaisler/leon3/Kconfig.sysbuild"
osource "C:/Users/vc9917e/zephyr_latest/zephyr/soc/gaisler/gr716a/Kconfig.sysbuild"
osource "C:/Users/vc9917e/zephyr_latest/zephyr/soc/espressif/Kconfig.sysbuild"
osource "C:/Users/vc9917e/zephyr_latest/zephyr/soc/ene/kb1200/Kconfig.sysbuild"
osource "C:/Users/vc9917e/zephyr_latest/zephyr/soc/efinix/sapphire/Kconfig.sysbuild"
osource "C:/Users/vc9917e/zephyr_latest/zephyr/soc/cypress/Kconfig.sysbuild"
osource "C:/Users/vc9917e/zephyr_latest/zephyr/soc/cdns/xtensa_sample_controller/Kconfig.sysbuild"
osource "C:/Users/vc9917e/zephyr_latest/zephyr/soc/cdns/dc233c/Kconfig.sysbuild"
osource "C:/Users/vc9917e/zephyr_latest/zephyr/soc/brcm/bcmvk/Kconfig.sysbuild"
osource "C:/Users/vc9917e/zephyr_latest/zephyr/soc/brcm/bcm2712/Kconfig.sysbuild"
osource "C:/Users/vc9917e/zephyr_latest/zephyr/soc/brcm/bcm2711/Kconfig.sysbuild"
osource "C:/Users/vc9917e/zephyr_latest/zephyr/soc/atmel/sam0/Kconfig.sysbuild"
osource "C:/Users/vc9917e/zephyr_latest/zephyr/soc/atmel/sam/Kconfig.sysbuild"
osource "C:/Users/vc9917e/zephyr_latest/zephyr/soc/aspeed/Kconfig.sysbuild"
osource "C:/Users/vc9917e/zephyr_latest/zephyr/soc/arm/Kconfig.sysbuild"
osource "C:/Users/vc9917e/zephyr_latest/zephyr/soc/arm/beetle/Kconfig.sysbuild"
osource "C:/Users/vc9917e/zephyr_latest/zephyr/soc/andestech/Kconfig.sysbuild"
osource "C:/Users/vc9917e/zephyr_latest/zephyr/soc/ambiq/Kconfig.sysbuild"
osource "C:/Users/vc9917e/zephyr_latest/zephyr/soc/altr/zephyr_nios2f/Kconfig.sysbuild"
osource "C:/Users/vc9917e/zephyr_latest/zephyr/soc/altr/qemu_nios2/Kconfig.sysbuild"
```

## samples/ifm_sample_app/build_nrf/Kconfig/Kconfig.modules
```kconfig
menu "acpica (C:/Users/vc9917e/zephyrproject/modules/lib/acpica)"
osource "$(ZEPHYR_ACPICA_KCONFIG)"
config ZEPHYR_ACPICA_MODULE
	bool
	default y
endmenu
menu "cmsis (C:/Users/vc9917e/zephyrproject/modules/hal/cmsis)"
osource "$(ZEPHYR_CMSIS_KCONFIG)"
config ZEPHYR_CMSIS_MODULE
	bool
	default y
endmenu
menu "cmsis-dsp (C:/Users/vc9917e/zephyrproject/modules/lib/cmsis-dsp)"
osource "$(ZEPHYR_CMSIS_DSP_KCONFIG)"
config ZEPHYR_CMSIS_DSP_MODULE
	bool
	default y
endmenu
menu "cmsis-nn (C:/Users/vc9917e/zephyrproject/modules/lib/cmsis-nn)"
osource "$(ZEPHYR_CMSIS_NN_KCONFIG)"
config ZEPHYR_CMSIS_NN_MODULE
	bool
	default y
endmenu
menu "fatfs (C:/Users/vc9917e/zephyrproject/modules/fs/fatfs)"
osource "$(ZEPHYR_FATFS_KCONFIG)"
config ZEPHYR_FATFS_MODULE
	bool
	default y
endmenu
config ZEPHYR_ALTERA_MODULE
   bool
   default y
menu "hal_ambiq (C:/Users/vc9917e/zephyrproject/modules/hal/ambiq)"
osource "$(ZEPHYR_HAL_AMBIQ_KCONFIG)"
config ZEPHYR_HAL_AMBIQ_MODULE
	bool
	default y
endmenu
config ZEPHYR_ATMEL_MODULE
   bool
   default y
menu "hal_espressif (C:/Users/vc9917e/zephyrproject/modules/hal/espressif)"
osource "C:/Users/vc9917e/zephyrproject/modules/hal/espressif/zephyr/Kconfig"
config ZEPHYR_HAL_ESPRESSIF_MODULE
	bool
	default y
	select TAINT_BLOBS
endmenu
menu "hal_ethos_u (C:/Users/vc9917e/zephyrproject/modules/hal/ethos_u)"
osource "$(ZEPHYR_HAL_ETHOS_U_KCONFIG)"
config ZEPHYR_HAL_ETHOS_U_MODULE
	bool
	default y
endmenu
menu "hal_gigadevice (C:/Users/vc9917e/zephyrproject/modules/hal/gigadevice)"
osource "$(ZEPHYR_HAL_GIGADEVICE_KCONFIG)"
config ZEPHYR_HAL_GIGADEVICE_MODULE
	bool
	default y
endmenu
menu "hal_infineon (C:/Users/vc9917e/zephyrproject/modules/hal/infineon)"
osource "$(ZEPHYR_HAL_INFINEON_KCONFIG)"
config ZEPHYR_HAL_INFINEON_MODULE
	bool
	default y
endmenu
config ZEPHYR_HAL_INTEL_MODULE
   bool
   default y
config ZEPHYR_MICROCHIP_MODULE
   bool
   default y
menu "hal_nordic (C:/Users/vc9917e/zephyrproject/modules/hal/nordic)"
osource "$(ZEPHYR_HAL_NORDIC_KCONFIG)"
config ZEPHYR_HAL_NORDIC_MODULE
	bool
	default y
endmenu
config ZEPHYR_NUVOTON_MODULE
   bool
   default y
menu "hal_nxp (C:/Users/vc9917e/zephyrproject/modules/hal/nxp)"
osource "$(ZEPHYR_HAL_NXP_KCONFIG)"
config ZEPHYR_HAL_NXP_MODULE
	bool
	default y
endmenu
config ZEPHYR_OPENISA_MODULE
   bool
   default y
config ZEPHYR_QUICKLOGIC_MODULE
   bool
   default y
config ZEPHYR_HAL_RENESAS_MODULE
   bool
   default y
menu "hal_rpi_pico (C:/Users/vc9917e/zephyrproject/modules/hal/rpi_pico)"
osource "$(ZEPHYR_HAL_RPI_PICO_KCONFIG)"
config ZEPHYR_HAL_RPI_PICO_MODULE
	bool
	default y
endmenu
menu "silabs (C:/Users/vc9917e/zephyrproject/modules/hal/silabs)"
osource "C:/Users/vc9917e/zephyrproject/modules/hal/silabs/zephyr/Kconfig"
config ZEPHYR_SILABS_MODULE
	bool
	default y
endmenu
menu "hal_st (C:/Users/vc9917e/zephyrproject/modules/hal/st)"
osource "$(ZEPHYR_HAL_ST_KCONFIG)"
config ZEPHYR_HAL_ST_MODULE
	bool
	default y
endmenu
config ZEPHYR_STM32_MODULE
   bool
   default y
menu "hal_telink (C:/Users/vc9917e/zephyrproject/modules/hal/telink)"
osource "C:/Users/vc9917e/zephyrproject/modules/hal/telink/Kconfig"
config ZEPHYR_HAL_TELINK_MODULE
	bool
	default y
endmenu
config ZEPHYR_TI_MODULE
   bool
   default y
config ZEPHYR_HAL_WURTHELEKTRONIK_MODULE
   bool
   default y
config ZEPHYR_XTENSA_MODULE
   bool
   default y
menu "hostap (C:/Users/vc9917e/zephyrproject/modules/lib/hostap)"
osource "$(ZEPHYR_HOSTAP_KCONFIG)"
config ZEPHYR_HOSTAP_MODULE
	bool
	default y
endmenu
config ZEPHYR_LIBMETAL_MODULE
   bool
   default y
menu "liblc3 (C:/Users/vc9917e/zephyrproject/modules/lib/liblc3)"
osource "$(ZEPHYR_LIBLC3_KCONFIG)"
config ZEPHYR_LIBLC3_MODULE
	bool
	default y
endmenu
menu "littlefs (C:/Users/vc9917e/zephyrproject/modules/fs/littlefs)"
osource "$(ZEPHYR_LITTLEFS_KCONFIG)"
config ZEPHYR_LITTLEFS_MODULE
	bool
	default y
endmenu
menu "loramac-node (C:/Users/vc9917e/zephyrproject/modules/lib/loramac-node)"
osource "$(ZEPHYR_LORAMAC_NODE_KCONFIG)"
config ZEPHYR_LORAMAC_NODE_MODULE
	bool
	default y
endmenu
menu "lvgl (C:/Users/vc9917e/zephyrproject/modules/lib/gui/lvgl)"
osource "C:/Users/vc9917e/zephyrproject/modules/lib/gui/lvgl/Kconfig"
config ZEPHYR_LVGL_MODULE
	bool
	default y
endmenu
menu "mbedtls (C:/Users/vc9917e/zephyrproject/modules/crypto/mbedtls)"
osource "$(ZEPHYR_MBEDTLS_KCONFIG)"
config ZEPHYR_MBEDTLS_MODULE
	bool
	default y
endmenu
config ZEPHYR_MCUBOOT_MODULE
   bool
   default y
config ZEPHYR_MIPI_SYS_T_MODULE
   bool
   default y
config ZEPHYR_NRF_HW_MODELS_MODULE
   bool
   default y
config ZEPHYR_OPEN_AMP_MODULE
   bool
   default y
menu "openthread (C:/Users/vc9917e/zephyrproject/modules/lib/openthread)"
osource "$(ZEPHYR_OPENTHREAD_KCONFIG)"
config ZEPHYR_OPENTHREAD_MODULE
	bool
	default y
endmenu
menu "percepio (C:/Users/vc9917e/zephyrproject/modules/debug/percepio)"
osource "C:/Users/vc9917e/zephyrproject/modules/debug/percepio/zephyr/Kconfig"
config ZEPHYR_PERCEPIO_MODULE
	bool
	default y
endmenu
menu "picolibc (C:/Users/vc9917e/zephyrproject/modules/lib/picolibc)"
osource "C:/Users/vc9917e/zephyrproject/modules/lib/picolibc/zephyr/Kconfig"
config ZEPHYR_PICOLIBC_MODULE
	bool
	default y
endmenu
menu "segger (C:/Users/vc9917e/zephyrproject/modules/debug/segger)"
osource "$(ZEPHYR_SEGGER_KCONFIG)"
config ZEPHYR_SEGGER_MODULE
	bool
	default y
endmenu
config ZEPHYR_TINYCRYPT_MODULE
   bool
   default y
menu "trusted-firmware-m (C:/Users/vc9917e/zephyrproject/modules/tee/tf-m/trusted-firmware-m)"
osource "$(ZEPHYR_TRUSTED_FIRMWARE_M_KCONFIG)"
config ZEPHYR_TRUSTED_FIRMWARE_M_MODULE
	bool
	default y
endmenu
menu "trusted-firmware-a (C:/Users/vc9917e/zephyrproject/modules/tee/tf-a/trusted-firmware-a)"
osource "$(ZEPHYR_TRUSTED_FIRMWARE_A_KCONFIG)"
config ZEPHYR_TRUSTED_FIRMWARE_A_MODULE
	bool
	default y
endmenu
menu "uoscore-uedhoc (C:/Users/vc9917e/zephyrproject/modules/lib/uoscore-uedhoc)"
osource "$(ZEPHYR_UOSCORE_UEDHOC_KCONFIG)"
config ZEPHYR_UOSCORE_UEDHOC_MODULE
	bool
	default y
endmenu
menu "zcbor (C:/Users/vc9917e/zephyrproject/modules/lib/zcbor)"
osource "$(ZEPHYR_ZCBOR_KCONFIG)"
config ZEPHYR_ZCBOR_MODULE
	bool
	default y
endmenu
menu "iolink (C:/Users/vc9917e/del/zephyr-iolm/samples/ifm_sample_app/../..)"
osource "C:/Users/vc9917e/del/zephyr-iolm/zephyr/KConfig"
config ZEPHYR_IOLINK_MODULE
	bool
	default y
endmenu
```

## samples/ifm_sample_app/build_nrf/Kconfig/arch/Kconfig
```kconfig
# Load arch Kconfig descriptions.
osource "C:/Users/vc9917e/zephyrproject/zephyr/arch/x86/Kconfig"
osource "C:/Users/vc9917e/zephyrproject/zephyr/arch/xtensa/Kconfig"
osource "C:/Users/vc9917e/zephyrproject/zephyr/arch/sparc/Kconfig"
osource "C:/Users/vc9917e/zephyrproject/zephyr/arch/riscv/Kconfig"
osource "C:/Users/vc9917e/zephyrproject/zephyr/arch/posix/Kconfig"
osource "C:/Users/vc9917e/zephyrproject/zephyr/arch/nios2/Kconfig"
osource "C:/Users/vc9917e/zephyrproject/zephyr/arch/mips/Kconfig"
osource "C:/Users/vc9917e/zephyrproject/zephyr/arch/arm64/Kconfig"
osource "C:/Users/vc9917e/zephyrproject/zephyr/arch/arm/Kconfig"
osource "C:/Users/vc9917e/zephyrproject/zephyr/arch/arc/Kconfig"
```
