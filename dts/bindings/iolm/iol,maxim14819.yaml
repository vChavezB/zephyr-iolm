## dts/bindings/iolm/iol,maxim14819.yaml
```yaml
# Copyright (c) 2024 Victor Chavez
# SPDX-License-Identifier: GPL-3.0-or-later

description: >
  Binding for the MAXIM14819 IOLM Transciever

compatible: "iolm,maxim14819"

include: [ spi-device.yaml ]

properties:
  irq-gpios:
    type: phandle-array
    required: true
    description: GPIO pin used for irq


  chip-address:
    description: SPI address of the transceiver
    type: int
    required: true

  IntE:
    description: Initial value of the InterruptEn register
    type: int

  CQCtrlA:
    description: Initial value of the CQCtrlA register
    type: int

  CQCtrlB:
    description: Initial value of the CQCtrlB register
    type: int

  LEDCtrl:
    description: Initial value of the LEDCtrl register
    type: int

  CQCfgA:
    description: Initial value of the CQCfgA register
    type: int

  CQCfgB:
    description: Initial value of the CQCfgB register
    type: int

  LPCnfgA:
    description: Initial value of the LPCnfgA register
    type: int

  LPCnfgB:
    description: Initial value of the LPCnfgB register
    type: int

  IOStCfgA:
    description: Initial value of the IOStCfgA register
    type: int

  IOStCfgB:
    description: Initial value of the IOStCfgB register
    type: int

  DrvCurrLim:
    description: Initial value of the DrvCurrLim register
    type: int

  Clock:
    description: Initial value of the Clock register
    type: int
```

## samples/ifm_sample_app/build_esp/Kconfig/arch/Kconfig
```kconfig
# Load arch Kconfig descriptions.
osource "C:/Users/vc9917e/zephyr_latest/zephyr/arch/x86/Kconfig"
osource "C:/Users/vc9917e/zephyr_latest/zephyr/arch/xtensa/Kconfig"
osource "C:/Users/vc9917e/zephyr_latest/zephyr/arch/sparc/Kconfig"
osource "C:/Users/vc9917e/zephyr_latest/zephyr/arch/riscv/Kconfig"
osource "C:/Users/vc9917e/zephyr_latest/zephyr/arch/posix/Kconfig"
osource "C:/Users/vc9917e/zephyr_latest/zephyr/arch/nios2/Kconfig"
osource "C:/Users/vc9917e/zephyr_latest/zephyr/arch/mips/Kconfig"
osource "C:/Users/vc9917e/zephyr_latest/zephyr/arch/arm64/Kconfig"
osource "C:/Users/vc9917e/zephyr_latest/zephyr/arch/arm/Kconfig"
osource "C:/Users/vc9917e/zephyr_latest/zephyr/arch/arc/Kconfig"
```

## samples/ifm_sample_app/build_esp/Kconfig/soc/Kconfig
```kconfig
# Load Zephyr SoC Kconfig descriptions.
osource "C:/Users/vc9917e/zephyr_latest/zephyr/soc/xlnx/zynqmp/Kconfig"
osource "C:/Users/vc9917e/zephyr_latest/zephyr/soc/xlnx/zynq7000/Kconfig"
osource "C:/Users/vc9917e/zephyr_latest/zephyr/soc/xen/Kconfig"
osource "C:/Users/vc9917e/zephyr_latest/zephyr/soc/ti/simplelink/Kconfig"
osource "C:/Users/vc9917e/zephyr_latest/zephyr/soc/ti/lm3s6965/Kconfig"
osource "C:/Users/vc9917e/zephyr_latest/zephyr/soc/ti/k3/Kconfig"
osource "C:/Users/vc9917e/zephyr_latest/zephyr/soc/telink/tlsr/Kconfig"
osource "C:/Users/vc9917e/zephyr_latest/zephyr/soc/starfive/jh71xx/Kconfig"
osource "C:/Users/vc9917e/zephyr_latest/zephyr/soc/st/stm32/Kconfig"
osource "C:/Users/vc9917e/zephyr_latest/zephyr/soc/snps/qemu_arc/Kconfig"
osource "C:/Users/vc9917e/zephyr_latest/zephyr/soc/snps/nsim/Kconfig"
osource "C:/Users/vc9917e/zephyr_latest/zephyr/soc/snps/hsdk4xd/Kconfig"
osource "C:/Users/vc9917e/zephyr_latest/zephyr/soc/snps/hsdk/Kconfig"
osource "C:/Users/vc9917e/zephyr_latest/zephyr/soc/snps/emsk/Kconfig"
osource "C:/Users/vc9917e/zephyr_latest/zephyr/soc/snps/emsdp/Kconfig"
osource "C:/Users/vc9917e/zephyr_latest/zephyr/soc/snps/arc_iot/Kconfig"
osource "C:/Users/vc9917e/zephyr_latest/zephyr/soc/silabs/Kconfig"
osource "C:/Users/vc9917e/zephyr_latest/zephyr/soc/sifive/sifive_freedom/Kconfig"
osource "C:/Users/vc9917e/zephyr_latest/zephyr/soc/rockchip/Kconfig"
osource "C:/Users/vc9917e/zephyr_latest/zephyr/soc/renode/riscv_virtual/Kconfig"
osource "C:/Users/vc9917e/zephyr_latest/zephyr/soc/renesas/smartbond/Kconfig"
osource "C:/Users/vc9917e/zephyr_latest/zephyr/soc/renesas/rzt2m/Kconfig"
osource "C:/Users/vc9917e/zephyr_latest/zephyr/soc/renesas/rcar/Kconfig"
osource "C:/Users/vc9917e/zephyr_latest/zephyr/soc/renesas/ra/Kconfig"
osource "C:/Users/vc9917e/zephyr_latest/zephyr/soc/raspberrypi/Kconfig"
osource "C:/Users/vc9917e/zephyr_latest/zephyr/soc/quicklogic/eos_s3/Kconfig"
osource "C:/Users/vc9917e/zephyr_latest/zephyr/soc/qemu/virt_riscv/Kconfig"
osource "C:/Users/vc9917e/zephyr_latest/zephyr/soc/qemu/malta/Kconfig"
osource "C:/Users/vc9917e/zephyr_latest/zephyr/soc/openisa/rv32m1/Kconfig"
osource "C:/Users/vc9917e/zephyr_latest/zephyr/soc/nxp/s32/Kconfig"
osource "C:/Users/vc9917e/zephyr_latest/zephyr/soc/nxp/rw/Kconfig"
osource "C:/Users/vc9917e/zephyr_latest/zephyr/soc/nxp/mcx/Kconfig"
osource "C:/Users/vc9917e/zephyr_latest/zephyr/soc/nxp/lpc/Kconfig"
osource "C:/Users/vc9917e/zephyr_latest/zephyr/soc/nxp/layerscape/Kconfig"
osource "C:/Users/vc9917e/zephyr_latest/zephyr/soc/nxp/kinetis/Kconfig"
osource "C:/Users/vc9917e/zephyr_latest/zephyr/soc/nxp/imxrt/Kconfig"
osource "C:/Users/vc9917e/zephyr_latest/zephyr/soc/nxp/imx/Kconfig"
osource "C:/Users/vc9917e/zephyr_latest/zephyr/soc/nuvoton/numicro/Kconfig"
osource "C:/Users/vc9917e/zephyr_latest/zephyr/soc/nuvoton/numaker/Kconfig"
osource "C:/Users/vc9917e/zephyr_latest/zephyr/soc/nuvoton/npcx/Kconfig"
osource "C:/Users/vc9917e/zephyr_latest/zephyr/soc/nordic/Kconfig"
osource "C:/Users/vc9917e/zephyr_latest/zephyr/soc/neorv32/Kconfig"
osource "C:/Users/vc9917e/zephyr_latest/zephyr/soc/native/inf_clock/Kconfig"
osource "C:/Users/vc9917e/zephyr_latest/zephyr/soc/microchip/miv/Kconfig"
osource "C:/Users/vc9917e/zephyr_latest/zephyr/soc/microchip/mec/Kconfig"
osource "C:/Users/vc9917e/zephyr_latest/zephyr/soc/lowrisc/opentitan/Kconfig"
osource "C:/Users/vc9917e/zephyr_latest/zephyr/soc/litex/litex_vexriscv/Kconfig"
osource "C:/Users/vc9917e/zephyr_latest/zephyr/soc/ite/ec/Kconfig"
osource "C:/Users/vc9917e/zephyr_latest/zephyr/soc/intel/raptor_lake/Kconfig"
osource "C:/Users/vc9917e/zephyr_latest/zephyr/soc/intel/lakemont/Kconfig"
osource "C:/Users/vc9917e/zephyr_latest/zephyr/soc/intel/intel_socfpga_std/Kconfig"
osource "C:/Users/vc9917e/zephyr_latest/zephyr/soc/intel/intel_socfpga/Kconfig"
osource "C:/Users/vc9917e/zephyr_latest/zephyr/soc/intel/intel_niosv/Kconfig"
osource "C:/Users/vc9917e/zephyr_latest/zephyr/soc/intel/intel_ish/Kconfig"
osource "C:/Users/vc9917e/zephyr_latest/zephyr/soc/intel/intel_adsp/Kconfig"
osource "C:/Users/vc9917e/zephyr_latest/zephyr/soc/intel/elkhart_lake/Kconfig"
osource "C:/Users/vc9917e/zephyr_latest/zephyr/soc/intel/atom/Kconfig"
osource "C:/Users/vc9917e/zephyr_latest/zephyr/soc/intel/apollo_lake/Kconfig"
osource "C:/Users/vc9917e/zephyr_latest/zephyr/soc/intel/alder_lake/Kconfig"
osource "C:/Users/vc9917e/zephyr_latest/zephyr/soc/infineon/xmc/Kconfig"
osource "C:/Users/vc9917e/zephyr_latest/zephyr/soc/gd/gd32/Kconfig"
osource "C:/Users/vc9917e/zephyr_latest/zephyr/soc/gaisler/leon3/Kconfig"
osource "C:/Users/vc9917e/zephyr_latest/zephyr/soc/gaisler/gr716a/Kconfig"
osource "C:/Users/vc9917e/zephyr_latest/zephyr/soc/espressif/Kconfig"
osource "C:/Users/vc9917e/zephyr_latest/zephyr/soc/ene/kb1200/Kconfig"
osource "C:/Users/vc9917e/zephyr_latest/zephyr/soc/efinix/sapphire/Kconfig"
osource "C:/Users/vc9917e/zephyr_latest/zephyr/soc/cypress/Kconfig"
osource "C:/Users/vc9917e/zephyr_latest/zephyr/soc/cdns/xtensa_sample_controller/Kconfig"
osource "C:/Users/vc9917e/zephyr_latest/zephyr/soc/cdns/dc233c/Kconfig"
osource "C:/Users/vc9917e/zephyr_latest/zephyr/soc/brcm/bcmvk/Kconfig"
osource "C:/Users/vc9917e/zephyr_latest/zephyr/soc/brcm/bcm2712/Kconfig"
osource "C:/Users/vc9917e/zephyr_latest/zephyr/soc/brcm/bcm2711/Kconfig"
osource "C:/Users/vc9917e/zephyr_latest/zephyr/soc/atmel/sam0/Kconfig"
osource "C:/Users/vc9917e/zephyr_latest/zephyr/soc/atmel/sam/Kconfig"
osource "C:/Users/vc9917e/zephyr_latest/zephyr/soc/aspeed/Kconfig"
osource "C:/Users/vc9917e/zephyr_latest/zephyr/soc/arm/Kconfig"
osource "C:/Users/vc9917e/zephyr_latest/zephyr/soc/arm/beetle/Kconfig"
osource "C:/Users/vc9917e/zephyr_latest/zephyr/soc/andestech/Kconfig"
osource "C:/Users/vc9917e/zephyr_latest/zephyr/soc/ambiq/Kconfig"
osource "C:/Users/vc9917e/zephyr_latest/zephyr/soc/altr/zephyr_nios2f/Kconfig"
osource "C:/Users/vc9917e/zephyr_latest/zephyr/soc/altr/qemu_nios2/Kconfig"
```

## samples/ifm_sample_app/build_esp/Kconfig/soc/Kconfig.soc
```kconfig
# Load SoC Kconfig descriptions.
osource "C:/Users/vc9917e/zephyr_latest/zephyr/soc/xlnx/zynqmp/Kconfig.soc"
osource "C:/Users/vc9917e/zephyr_latest/zephyr/soc/xlnx/zynq7000/Kconfig.soc"
osource "C:/Users/vc9917e/zephyr_latest/zephyr/soc/xen/Kconfig.soc"
osource "C:/Users/vc9917e/zephyr_latest/zephyr/soc/ti/simplelink/Kconfig.soc"
osource "C:/Users/vc9917e/zephyr_latest/zephyr/soc/ti/lm3s6965/Kconfig.soc"
osource "C:/Users/vc9917e/zephyr_latest/zephyr/soc/ti/k3/Kconfig.soc"
osource "C:/Users/vc9917e/zephyr_latest/zephyr/soc/telink/tlsr/Kconfig.soc"
osource "C:/Users/vc9917e/zephyr_latest/zephyr/soc/starfive/jh71xx/Kconfig.soc"
osource "C:/Users/vc9917e/zephyr_latest/zephyr/soc/st/stm32/Kconfig.soc"
osource "C:/Users/vc9917e/zephyr_latest/zephyr/soc/snps/qemu_arc/Kconfig.soc"
osource "C:/Users/vc9917e/zephyr_latest/zephyr/soc/snps/nsim/Kconfig.soc"
osource "C:/Users/vc9917e/zephyr_latest/zephyr/soc/snps/hsdk4xd/Kconfig.soc"
osource "C:/Users/vc9917e/zephyr_latest/zephyr/soc/snps/hsdk/Kconfig.soc"
osource "C:/Users/vc9917e/zephyr_latest/zephyr/soc/snps/emsk/Kconfig.soc"
osource "C:/Users/vc9917e/zephyr_latest/zephyr/soc/snps/emsdp/Kconfig.soc"
osource "C:/Users/vc9917e/zephyr_latest/zephyr/soc/snps/arc_iot/Kconfig.soc"
osource "C:/Users/vc9917e/zephyr_latest/zephyr/soc/silabs/Kconfig.soc"
osource "C:/Users/vc9917e/zephyr_latest/zephyr/soc/sifive/sifive_freedom/Kconfig.soc"
osource "C:/Users/vc9917e/zephyr_latest/zephyr/soc/rockchip/Kconfig.soc"
osource "C:/Users/vc9917e/zephyr_latest/zephyr/soc/renode/riscv_virtual/Kconfig.soc"
osource "C:/Users/vc9917e/zephyr_latest/zephyr/soc/renesas/smartbond/Kconfig.soc"
osource "C:/Users/vc9917e/zephyr_latest/zephyr/soc/renesas/rzt2m/Kconfig.soc"
osource "C:/Users/vc9917e/zephyr_latest/zephyr/soc/renesas/rcar/Kconfig.soc"
osource "C:/Users/vc9917e/zephyr_latest/zephyr/soc/renesas/ra/Kconfig.soc"
osource "C:/Users/vc9917e/zephyr_latest/zephyr/soc/raspberrypi/Kconfig.soc"
osource "C:/Users/vc9917e/zephyr_latest/zephyr/soc/quicklogic/eos_s3/Kconfig.soc"
osource "C:/Users/vc9917e/zephyr_latest/zephyr/soc/qemu/virt_riscv/Kconfig.soc"
osource "C:/Users/vc9917e/zephyr_latest/zephyr/soc/qemu/malta/Kconfig.soc"
osource "C:/Users/vc9917e/zephyr_latest/zephyr/soc/openisa/rv32m1/Kconfig.soc"
osource "C:/Users/vc9917e/zephyr_latest/zephyr/soc/nxp/s32/Kconfig.soc"
osource "C:/Users/vc9917e/zephyr_latest/zephyr/soc/nxp/rw/Kconfig.soc"
osource "C:/Users/vc9917e/zephyr_latest/zephyr/soc/nxp/mcx/Kconfig.soc"
osource "C:/Users/vc9917e/zephyr_latest/zephyr/soc/nxp/lpc/Kconfig.soc"
osource "C:/Users/vc9917e/zephyr_latest/zephyr/soc/nxp/layerscape/Kconfig.soc"
osource "C:/Users/vc9917e/zephyr_latest/zephyr/soc/nxp/kinetis/Kconfig.soc"
osource "C:/Users/vc9917e/zephyr_latest/zephyr/soc/nxp/imxrt/Kconfig.soc"
osource "C:/Users/vc9917e/zephyr_latest/zephyr/soc/nxp/imx/Kconfig.soc"
osource "C:/Users/vc9917e/zephyr_latest/zephyr/soc/nuvoton/numicro/Kconfig.soc"
osource "C:/Users/vc9917e/zephyr_latest/zephyr/soc/nuvoton/numaker/Kconfig.soc"
osource "C:/Users/vc9917e/zephyr_latest/zephyr/soc/nuvoton/npcx/Kconfig.soc"
osource "C:/Users/vc9917e/zephyr_latest/zephyr/soc/nordic/Kconfig.soc"
osource "C:/Users/vc9917e/zephyr_latest/zephyr/soc/neorv32/Kconfig.soc"
osource "C:/Users/vc9917e/zephyr_latest/zephyr/soc/native/inf_clock/Kconfig.soc"
osource "C:/Users/vc9917e/zephyr_latest/zephyr/soc/microchip/miv/Kconfig.soc"
osource "C:/Users/vc9917e/zephyr_latest/zephyr/soc/microchip/mec/Kconfig.soc"
osource "C:/Users/vc9917e/zephyr_latest/zephyr/soc/lowrisc/opentitan/Kconfig.soc"
osource "C:/Users/vc9917e/zephyr_latest/zephyr/soc/litex/litex_vexriscv/Kconfig.soc"
osource "C:/Users/vc9917e/zephyr_latest/zephyr/soc/ite/ec/Kconfig.soc"
osource "C:/Users/vc9917e/zephyr_latest/zephyr/soc/intel/raptor_lake/Kconfig.soc"
osource "C:/Users/vc9917e/zephyr_latest/zephyr/soc/intel/lakemont/Kconfig.soc"
osource "C:/Users/vc9917e/zephyr_latest/zephyr/soc/intel/intel_socfpga_std/Kconfig.soc"
osource "C:/Users/vc9917e/zephyr_latest/zephyr/soc/intel/intel_socfpga/Kconfig.soc"
osource "C:/Users/vc9917e/zephyr_latest/zephyr/soc/intel/intel_niosv/Kconfig.soc"
osource "C:/Users/vc9917e/zephyr_latest/zephyr/soc/intel/intel_ish/Kconfig.soc"
osource "C:/Users/vc9917e/zephyr_latest/zephyr/soc/intel/intel_adsp/Kconfig.soc"
osource "C:/Users/vc9917e/zephyr_latest/zephyr/soc/intel/elkhart_lake/Kconfig.soc"
osource "C:/Users/vc9917e/zephyr_latest/zephyr/soc/intel/atom/Kconfig.soc"
osource "C:/Users/vc9917e/zephyr_latest/zephyr/soc/intel/apollo_lake/Kconfig.soc"
osource "C:/Users/vc9917e/zephyr_latest/zephyr/soc/intel/alder_lake/Kconfig.soc"
osource "C:/Users/vc9917e/zephyr_latest/zephyr/soc/infineon/xmc/Kconfig.soc"
osource "C:/Users/vc9917e/zephyr_latest/zephyr/soc/gd/gd32/Kconfig.soc"
osource "C:/Users/vc9917e/zephyr_latest/zephyr/soc/gaisler/leon3/Kconfig.soc"
osource "C:/Users/vc9917e/zephyr_latest/zephyr/soc/gaisler/gr716a/Kconfig.soc"
osource "C:/Users/vc9917e/zephyr_latest/zephyr/soc/espressif/Kconfig.soc"
osource "C:/Users/vc9917e/zephyr_latest/zephyr/soc/ene/kb1200/Kconfig.soc"
osource "C:/Users/vc9917e/zephyr_latest/zephyr/soc/efinix/sapphire/Kconfig.soc"
osource "C:/Users/vc9917e/zephyr_latest/zephyr/soc/cypress/Kconfig.soc"
osource "C:/Users/vc9917e/zephyr_latest/zephyr/soc/cdns/xtensa_sample_controller/Kconfig.soc"
osource "C:/Users/vc9917e/zephyr_latest/zephyr/soc/cdns/dc233c/Kconfig.soc"
osource "C:/Users/vc9917e/zephyr_latest/zephyr/soc/brcm/bcmvk/Kconfig.soc"
osource "C:/Users/vc9917e/zephyr_latest/zephyr/soc/brcm/bcm2712/Kconfig.soc"
osource "C:/Users/vc9917e/zephyr_latest/zephyr/soc/brcm/bcm2711/Kconfig.soc"
osource "C:/Users/vc9917e/zephyr_latest/zephyr/soc/atmel/sam0/Kconfig.soc"
osource "C:/Users/vc9917e/zephyr_latest/zephyr/soc/atmel/sam/Kconfig.soc"
osource "C:/Users/vc9917e/zephyr_latest/zephyr/soc/aspeed/Kconfig.soc"
osource "C:/Users/vc9917e/zephyr_latest/zephyr/soc/arm/Kconfig.soc"
osource "C:/Users/vc9917e/zephyr_latest/zephyr/soc/arm/beetle/Kconfig.soc"
osource "C:/Users/vc9917e/zephyr_latest/zephyr/soc/andestech/Kconfig.soc"
osource "C:/Users/vc9917e/zephyr_latest/zephyr/soc/ambiq/Kconfig.soc"
osource "C:/Users/vc9917e/zephyr_latest/zephyr/soc/altr/zephyr_nios2f/Kconfig.soc"
osource "C:/Users/vc9917e/zephyr_latest/zephyr/soc/altr/qemu_nios2/Kconfig.soc"
```
