## samples/ifm_sample_app/build_nrf/Kconfig/soc/Kconfig.sysbuild
```kconfig
# Load SoC sysbuild Kconfig descriptions.
osource "C:/Users/vc9917e/zephyrproject/zephyr/soc/xlnx/zynqmp/Kconfig.sysbuild"
osource "C:/Users/vc9917e/zephyrproject/zephyr/soc/xlnx/zynq7000/Kconfig.sysbuild"
osource "C:/Users/vc9917e/zephyrproject/zephyr/soc/xen/Kconfig.sysbuild"
osource "C:/Users/vc9917e/zephyrproject/zephyr/soc/ti/simplelink/Kconfig.sysbuild"
osource "C:/Users/vc9917e/zephyrproject/zephyr/soc/ti/lm3s6965/Kconfig.sysbuild"
osource "C:/Users/vc9917e/zephyrproject/zephyr/soc/ti/k3/Kconfig.sysbuild"
osource "C:/Users/vc9917e/zephyrproject/zephyr/soc/telink/tlsr/Kconfig.sysbuild"
osource "C:/Users/vc9917e/zephyrproject/zephyr/soc/starfive/jh71xx/Kconfig.sysbuild"
osource "C:/Users/vc9917e/zephyrproject/zephyr/soc/st/stm32/Kconfig.sysbuild"
osource "C:/Users/vc9917e/zephyrproject/zephyr/soc/snps/qemu_arc/Kconfig.sysbuild"
osource "C:/Users/vc9917e/zephyrproject/zephyr/soc/snps/nsim/Kconfig.sysbuild"
osource "C:/Users/vc9917e/zephyrproject/zephyr/soc/snps/hsdk4xd/Kconfig.sysbuild"
osource "C:/Users/vc9917e/zephyrproject/zephyr/soc/snps/hsdk/Kconfig.sysbuild"
osource "C:/Users/vc9917e/zephyrproject/zephyr/soc/snps/emsk/Kconfig.sysbuild"
osource "C:/Users/vc9917e/zephyrproject/zephyr/soc/snps/emsdp/Kconfig.sysbuild"
osource "C:/Users/vc9917e/zephyrproject/zephyr/soc/snps/arc_iot/Kconfig.sysbuild"
osource "C:/Users/vc9917e/zephyrproject/zephyr/soc/silabs/Kconfig.sysbuild"
osource "C:/Users/vc9917e/zephyrproject/zephyr/soc/sifive/sifive_freedom/Kconfig.sysbuild"
osource "C:/Users/vc9917e/zephyrproject/zephyr/soc/rockchip/Kconfig.sysbuild"
osource "C:/Users/vc9917e/zephyrproject/zephyr/soc/renode/riscv_virtual/Kconfig.sysbuild"
osource "C:/Users/vc9917e/zephyrproject/zephyr/soc/renesas/smartbond/Kconfig.sysbuild"
osource "C:/Users/vc9917e/zephyrproject/zephyr/soc/renesas/rzt2m/Kconfig.sysbuild"
osource "C:/Users/vc9917e/zephyrproject/zephyr/soc/renesas/rcar/Kconfig.sysbuild"
osource "C:/Users/vc9917e/zephyrproject/zephyr/soc/renesas/ra/Kconfig.sysbuild"
osource "C:/Users/vc9917e/zephyrproject/zephyr/soc/raspberrypi/Kconfig.sysbuild"
osource "C:/Users/vc9917e/zephyrproject/zephyr/soc/quicklogic/eos_s3/Kconfig.sysbuild"
osource "C:/Users/vc9917e/zephyrproject/zephyr/soc/qemu/virt_riscv/Kconfig.sysbuild"
osource "C:/Users/vc9917e/zephyrproject/zephyr/soc/qemu/malta/Kconfig.sysbuild"
osource "C:/Users/vc9917e/zephyrproject/zephyr/soc/openisa/rv32m1/Kconfig.sysbuild"
osource "C:/Users/vc9917e/zephyrproject/zephyr/soc/nxp/s32/Kconfig.sysbuild"
osource "C:/Users/vc9917e/zephyrproject/zephyr/soc/nxp/rw/Kconfig.sysbuild"
osource "C:/Users/vc9917e/zephyrproject/zephyr/soc/nxp/mcx/Kconfig.sysbuild"
osource "C:/Users/vc9917e/zephyrproject/zephyr/soc/nxp/lpc/Kconfig.sysbuild"
osource "C:/Users/vc9917e/zephyrproject/zephyr/soc/nxp/layerscape/Kconfig.sysbuild"
osource "C:/Users/vc9917e/zephyrproject/zephyr/soc/nxp/kinetis/Kconfig.sysbuild"
osource "C:/Users/vc9917e/zephyrproject/zephyr/soc/nxp/imxrt/Kconfig.sysbuild"
osource "C:/Users/vc9917e/zephyrproject/zephyr/soc/nxp/imx/Kconfig.sysbuild"
osource "C:/Users/vc9917e/zephyrproject/zephyr/soc/nuvoton/numicro/Kconfig.sysbuild"
osource "C:/Users/vc9917e/zephyrproject/zephyr/soc/nuvoton/numaker/Kconfig.sysbuild"
osource "C:/Users/vc9917e/zephyrproject/zephyr/soc/nuvoton/npcx/Kconfig.sysbuild"
osource "C:/Users/vc9917e/zephyrproject/zephyr/soc/nordic/Kconfig.sysbuild"
osource "C:/Users/vc9917e/zephyrproject/zephyr/soc/neorv32/Kconfig.sysbuild"
osource "C:/Users/vc9917e/zephyrproject/zephyr/soc/native/inf_clock/Kconfig.sysbuild"
osource "C:/Users/vc9917e/zephyrproject/zephyr/soc/microchip/miv/Kconfig.sysbuild"
osource "C:/Users/vc9917e/zephyrproject/zephyr/soc/microchip/mec/Kconfig.sysbuild"
osource "C:/Users/vc9917e/zephyrproject/zephyr/soc/lowrisc/opentitan/Kconfig.sysbuild"
osource "C:/Users/vc9917e/zephyrproject/zephyr/soc/litex/litex_vexriscv/Kconfig.sysbuild"
osource "C:/Users/vc9917e/zephyrproject/zephyr/soc/ite/ec/Kconfig.sysbuild"
osource "C:/Users/vc9917e/zephyrproject/zephyr/soc/intel/raptor_lake/Kconfig.sysbuild"
osource "C:/Users/vc9917e/zephyrproject/zephyr/soc/intel/lakemont/Kconfig.sysbuild"
osource "C:/Users/vc9917e/zephyrproject/zephyr/soc/intel/intel_socfpga_std/Kconfig.sysbuild"
osource "C:/Users/vc9917e/zephyrproject/zephyr/soc/intel/intel_socfpga/Kconfig.sysbuild"
osource "C:/Users/vc9917e/zephyrproject/zephyr/soc/intel/intel_niosv/Kconfig.sysbuild"
osource "C:/Users/vc9917e/zephyrproject/zephyr/soc/intel/intel_ish/Kconfig.sysbuild"
osource "C:/Users/vc9917e/zephyrproject/zephyr/soc/intel/intel_adsp/Kconfig.sysbuild"
osource "C:/Users/vc9917e/zephyrproject/zephyr/soc/intel/elkhart_lake/Kconfig.sysbuild"
osource "C:/Users/vc9917e/zephyrproject/zephyr/soc/intel/atom/Kconfig.sysbuild"
osource "C:/Users/vc9917e/zephyrproject/zephyr/soc/intel/apollo_lake/Kconfig.sysbuild"
osource "C:/Users/vc9917e/zephyrproject/zephyr/soc/intel/alder_lake/Kconfig.sysbuild"
osource "C:/Users/vc9917e/zephyrproject/zephyr/soc/infineon/xmc/Kconfig.sysbuild"
osource "C:/Users/vc9917e/zephyrproject/zephyr/soc/gd/gd32/Kconfig.sysbuild"
osource "C:/Users/vc9917e/zephyrproject/zephyr/soc/gaisler/leon3/Kconfig.sysbuild"
osource "C:/Users/vc9917e/zephyrproject/zephyr/soc/gaisler/gr716a/Kconfig.sysbuild"
osource "C:/Users/vc9917e/zephyrproject/zephyr/soc/espressif/Kconfig.sysbuild"
osource "C:/Users/vc9917e/zephyrproject/zephyr/soc/ene/kb1200/Kconfig.sysbuild"
osource "C:/Users/vc9917e/zephyrproject/zephyr/soc/efinix/sapphire/Kconfig.sysbuild"
osource "C:/Users/vc9917e/zephyrproject/zephyr/soc/cypress/Kconfig.sysbuild"
osource "C:/Users/vc9917e/zephyrproject/zephyr/soc/cdns/xtensa_sample_controller/Kconfig.sysbuild"
osource "C:/Users/vc9917e/zephyrproject/zephyr/soc/cdns/dc233c/Kconfig.sysbuild"
osource "C:/Users/vc9917e/zephyrproject/zephyr/soc/brcm/bcmvk/Kconfig.sysbuild"
osource "C:/Users/vc9917e/zephyrproject/zephyr/soc/brcm/bcm2712/Kconfig.sysbuild"
osource "C:/Users/vc9917e/zephyrproject/zephyr/soc/brcm/bcm2711/Kconfig.sysbuild"
osource "C:/Users/vc9917e/zephyrproject/zephyr/soc/atmel/sam0/Kconfig.sysbuild"
osource "C:/Users/vc9917e/zephyrproject/zephyr/soc/atmel/sam/Kconfig.sysbuild"
osource "C:/Users/vc9917e/zephyrproject/zephyr/soc/aspeed/Kconfig.sysbuild"
osource "C:/Users/vc9917e/zephyrproject/zephyr/soc/arm/Kconfig.sysbuild"
osource "C:/Users/vc9917e/zephyrproject/zephyr/soc/arm/beetle/Kconfig.sysbuild"
osource "C:/Users/vc9917e/zephyrproject/zephyr/soc/andestech/Kconfig.sysbuild"
osource "C:/Users/vc9917e/zephyrproject/zephyr/soc/ambiq/Kconfig.sysbuild"
osource "C:/Users/vc9917e/zephyrproject/zephyr/soc/altr/zephyr_nios2f/Kconfig.sysbuild"
osource "C:/Users/vc9917e/zephyrproject/zephyr/soc/altr/qemu_nios2/Kconfig.sysbuild"
```

## samples/read_pd/Kconfig
```kconfig
# Copyright (c) 2024 Victor Chavez
# SPDX-License-Identifier: GPL-3.0-or-later
mainmenu "Zephyr IOLM PDIn sample application"

config PDIN_RATE_MS
	int "VLAN tag for second interface"
	default 1000
	help
	  Rate to print IO-Link Device PDIn data in milliseconds

config CYCLE_TIME_US
    int "VLAN tag for second interface"
    default 50000
    help
      Cycle time in microseconds for each port


source "Kconfig.zephyr"
```

## zephyr/KConfig
```kconfig
# Copyright (c) 2024 Victor Chavez
# SPDX-License-Identifier: GPL-3.0-or-later

config IOLINK
    bool "IOLink Master"
    default n
	select EVENTS
    help
        Enables the IOLink Master Module
        
if IOLINK

module = IOLINK
module-str = iolink

config IOLINK_MAIN_STACK_SIZE
	int "Main stack size for the IO-Link Master task"
	default 4096

config IOLINK_DL_STACK_SIZE
	int "IO-Link Master data layer stack size"
	default 2048


config IOLINK_PRIO
	int "IO-Link Master task priority"
	default 6

config IOLINK_NUM_PORTS
	int "Number of IO-Link ports"
	default 2
	range 2 8
	help
	  Total Number of IO-Link Master ports that the application will support


config IOLINK_DIAG_ENTRIES
	int "Number of IO-Link ports"
	default 64
	help
	  Total Number of diagnostic entries

config IOLINK_MAX_EVENTS
	int "Number of IO-Link ports"
	default 6
	help
	  Maximum number of io-link events

choice "$(module)_LOG_LEVEL_CHOICE"
	prompt "Max compiled-in log level for $(module-str)"
	default $(module)_LOG_LEVEL_DEFAULT
	depends on LOG

config $(module)_LOG_LEVEL_OFF
	bool "Off"

config $(module)_LOG_LEVEL_ERR
	bool "Error"

config $(module)_LOG_LEVEL_WRN
	bool "Warning"

config $(module)_LOG_LEVEL_INF
	bool "Info"

config $(module)_LOG_LEVEL_DBG
	bool "Debug"

config $(module)_LOG_LEVEL_DEFAULT
	bool "Default"

endchoice

config $(module)_LOG_LEVEL
	int
	depends on LOG
	default 0 if $(module)_LOG_LEVEL_OFF
	default 1 if $(module)_LOG_LEVEL_ERR
	default 2 if $(module)_LOG_LEVEL_WRN
	default 3 if $(module)_LOG_LEVEL_INF
	default 4 if $(module)_LOG_LEVEL_DBG
	default LOG_DEFAULT_LEVEL if $(module)_LOG_LEVEL_DEFAULT


endif
```
